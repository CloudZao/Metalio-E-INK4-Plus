## main/Kconfig.projbuild
```kconfig
menu "Metalio E-Ink4-Plus"

choice BOARD_TYPE
    prompt "Board Type"
    default BOARD_TYPE_METALIO_E_INK4_PLUS
    help
        S31 并行墨水屏 + 百问 AI。

    config BOARD_TYPE_METALIO_E_INK4_PLUS
        bool "Metalio E-Ink4-Plus (4.7 parallel)"
        depends on IDF_TARGET_ESP32S31

    config BOARD_TYPE_METALIO_E_INK4_PLUS_GLOBAL
        bool "Metalio E-Ink4-Plus Global (4.7 parallel)"
        depends on IDF_TARGET_ESP32S31
endchoice

choice WAKE_WORD_TYPE
    prompt "Wake word implementation"
    default WAKE_WORD_DISABLED
    help
        百问为 PTT；默认关闭唤醒词。

    config WAKE_WORD_DISABLED
        bool "Disabled"
    config USE_ESP_WAKE_WORD
        bool "ESP Wake Word"
    config USE_AFE_WAKE_WORD
        bool "AFE Wake Word"
        depends on SPIRAM
    config USE_CUSTOM_WAKE_WORD
        bool "Custom Wake Word"
endchoice

config USE_AUDIO_PROCESSOR
    bool "Enable audio processor (AFE)"
    default n
    depends on SPIRAM
    help
        VAD/AEC 处理；S31 无 esp-sr 时关，走 no_audio_processor。

config USE_DEVICE_AEC
    bool "Device AEC"
    default n
    depends on USE_AUDIO_PROCESSOR

config USE_SERVER_AEC
    bool "Server AEC"
    default n
    depends on USE_AUDIO_PROCESSOR

config METALIO_TOUCH_UPGRADE_ON_BOOT
    bool "Upgrade FT6336U touch firmware to V04 on boot / 启动时升级触摸固件至 V04"
    default y
    help
        Only for the LT0470GF0430M 684x1216 FT6336U panel. Runs before
        touch/display tasks start, using the embedded supplier app image.
        Checks chip and bootloader IDs, packet status, XOR and final version.
        Skips V04; all other versions are updated to V04. Keep power connected throughout the
        update. Not for other touch panels.
        仅适用于本板触摸屏；启动时检查版本，非 0x04 时升级到 V04，
        版本相同时跳过。升级期间保持供电。

config USE_AUDIO_DEBUGGER
    bool "Audio debugger"
    default n

endmenu
```

## sdkconfig.defaults
```kconfig
CONFIG_ESPTOOLPY_FLASHSIZE_16MB=y
CONFIG_PARTITION_TABLE_CUSTOM=y
CONFIG_PARTITION_TABLE_CUSTOM_FILENAME="partitions.csv"
CONFIG_COMPILER_DISABLE_DEFAULT_ERRORS=y
CONFIG_I2C_SUPPRESS_DEPRECATE_WARN=y
CONFIG_BOARD_TYPE_METALIO_E_INK4_PLUS=y

CONFIG_LV_CONF_SKIP=y
CONFIG_LV_COLOR_DEPTH_1=y
CONFIG_LV_FONT_MONTSERRAT_28=y
CONFIG_LV_DRAW_SW_I1_LUM_THRESHOLD=16
CONFIG_LV_USE_CLIB_MALLOC=y
CONFIG_LV_USE_CLIB_STRING=y
CONFIG_LV_USE_CLIB_SPRINTF=y
CONFIG_LV_OS_NONE=y
CONFIG_LV_USE_DRAW_SW=y
CONFIG_LV_DRAW_SW_SUPPORT_I1=y
CONFIG_LV_USE_LODEPNG=y
CONFIG_SPIRAM=y
CONFIG_SPIRAM_USE_MALLOC=y
CONFIG_ESP_WIFI_STATIC_RX_BUFFER_NUM=3
CONFIG_ESP_WIFI_DYNAMIC_RX_BUFFER_NUM=6
CONFIG_ESP_WIFI_DYNAMIC_RX_MGMT_BUFFER=y

CONFIG_FREERTOS_GENERATE_RUN_TIME_STATS=y
CONFIG_FREERTOS_USE_TRACE_FACILITY=y
CONFIG_FREERTOS_USE_STATS_FORMATTING_FUNCTIONS=y
CONFIG_FREERTOS_RUN_TIME_STATS_USING_ESP_TIMER=y
CONFIG_FREERTOS_RUN_TIME_COUNTER_TYPE_U32=y

# HomeScreen 创建 + 首次 lv_refr（标签/字体/SPNG）在 main 上跑，默认 3584 会 Stack protection fault
CONFIG_ESP_MAIN_TASK_STACK_SIZE=16384

# 墨水屏 GC16/全屏 blit 可阻塞数秒；默认 5s 会误报 IDLE0 task_wdt
CONFIG_ESP_TASK_WDT_TIMEOUT_S=20

# 首页图标 A:*.spng
CONFIG_ESP_LVGL_ADAPTER_ENABLE_FS=y
CONFIG_ESP_LVGL_ADAPTER_ENABLE_DECODER=y

# 书架书名来自 SD 文件名；中文 LFN 需 UTF-8 API + CP936，否则退回 8.3/乱码，LVGL 画成方框
CONFIG_FATFS_LFN_HEAP=y
CONFIG_FATFS_CODEPAGE_936=y
CONFIG_FATFS_API_ENCODING_UTF_8=y
```

## sdkconfig.defaults.esp32s31
```kconfig
CONFIG_ESPTOOLPY_FLASHSIZE_16MB=y
CONFIG_PARTITION_TABLE_CUSTOM=y
CONFIG_PARTITION_TABLE_CUSTOM_FILENAME="partitions/v1/16m.csv"
CONFIG_SPIRAM=y
CONFIG_SPIRAM_MODE_OCT=y
CONFIG_SPIRAM_SPEED_200M=y
CONFIG_SPIRAM_USE_MALLOC=y
CONFIG_SPIRAM_MALLOC_ALWAYSINTERNAL=16
CONFIG_SPIRAM_MALLOC_RESERVE_INTERNAL=65536
CONFIG_SPIRAM_BOOT_INIT=y
CONFIG_ESP_WIFI_STATIC_RX_BUFFER_NUM=6
CONFIG_ESP_WIFI_DYNAMIC_RX_BUFFER_NUM=32
# CONFIG_ESP_WIFI_DYNAMIC_RX_MGMT_BUFFER is not set

# S31：按对照启动日志对齐 Wi-Fi/lwIP；PSRAM 优先模式使用 SDK 要求的静态 TX。
CONFIG_LWIP_TCP_WND_DEFAULT=32768
CONFIG_LWIP_TCP_RECVMBOX_SIZE=32
CONFIG_LWIP_TCP_OOSEQ_MAX_PBUFS=12
CONFIG_LWIP_TCP_SACK_OUT=y

# 对齐 397：AppIdle 空闲降频依赖 esp_pm
CONFIG_PM_ENABLE=y
CONFIG_PM_RTOS_IDLE_OPT=y
CONFIG_PM_SLP_DISABLE_GPIO=y

# 设置→存储：TinyUSB MSC 模拟 U 盘（S31 HS）
CONFIG_TINYUSB_MSC_ENABLED=y
CONFIG_TINYUSB_MSC_BUFSIZE=8192
CONFIG_TINYUSB_MSC_MOUNT_PATH="/sdcard"
CONFIG_TINYUSB_DESC_MANUFACTURER_STRING="Metalio"
CONFIG_TINYUSB_DESC_PRODUCT_STRING="Metalio Ink SD"
CONFIG_TINYUSB_DESC_SERIAL_STRING="123456"
CONFIG_TINYUSB_DESC_MSC_STRING="Metalio MSC"

CONFIG_ESP_WIFI_RX_BA_WIN=12

CONFIG_ESP_WIFI_AMPDU_TX_ENABLED=y

CONFIG_ESP_WIFI_AMPDU_RX_ENABLED=y

CONFIG_LWIP_TCPIP_RECVMBOX_SIZE=32

CONFIG_LWIP_SO_RCVBUF=y
CONFIG_SPIRAM_TRY_ALLOCATE_WIFI_LWIP=y
CONFIG_ESP_WIFI_STATIC_TX_BUFFER=y
# CONFIG_ESP_WIFI_DYNAMIC_TX_BUFFER is not set
CONFIG_ESP_WIFI_TX_BUFFER_TYPE=0
CONFIG_ESP_WIFI_STATIC_TX_BUFFER_NUM=6
CONFIG_ESP_WIFI_CACHE_TX_BUFFER_NUM=4
CONFIG_ESP_WIFI_TX_BA_WIN=64
CONFIG_ESP_WIFI_STATIC_RX_MGMT_BUFFER=y
CONFIG_ESP_WIFI_RX_MGMT_BUF_NUM_DEF=5
CONFIG_LWIP_TCP_SND_BUF_DEFAULT=5760
CONFIG_LWIP_TCP_MSS=1440

CONFIG_HTTPD_MAX_URI_LEN=1600

# Reserve internal RAM for DMA and concurrent Wi-Fi/BLE; keep host state in PSRAM.
CONFIG_SPIRAM_ALLOW_BSS_SEG_EXTERNAL_MEMORY=y
# CONFIG_BT_NIMBLE_MEM_ALLOC_MODE_INTERNAL is not set
CONFIG_BT_NIMBLE_MEM_ALLOC_MODE_EXTERNAL=y
# CONFIG_ESP_WIFI_IRAM_OPT is not set
# CONFIG_ESP_WIFI_RX_IRAM_OPT is not set
# CONFIG_ESP_WIFI_EXTRA_IRAM_OPT is not set
```
