## main/Kconfig.projbuild
```kconfig
menu "Hardware configuration / 硬件配置"

choice BOARD_TYPE
    prompt "Board / 硬件板型"
    default BOARD_TYPE_METALIO_E_INK_4 if IDF_TARGET_ESP32S3
    default BOARD_TYPE_METALIO_E_INK4_PLUS
    help
        Select the board matching the chip, panel and power wiring.
        选择匹配芯片、屏幕与供电连接的硬件板型，产品版本单独选择。

    config BOARD_TYPE_METALIO_E_INK4_PLUS
        bool "Metalio E-Ink4-Plus (4.7 parallel)"
        depends on IDF_TARGET_ESP32S31

    config BOARD_TYPE_METALIO_E_INK_4
        bool "Metalio E-Ink4 (3.97 SPI)"
        depends on IDF_TARGET_ESP32S3
endchoice

choice PRODUCT_VARIANT
    prompt "Product variant / 产品版本"
    default PRODUCT_DOMESTIC
    config PRODUCT_DOMESTIC
        bool "Domestic / 国内版"
    config PRODUCT_GLOBAL
        bool "International / 国际版"
endchoice

# 兼容已有代码使用的国际版板型符号，不再作为独立硬件选项。
config BOARD_TYPE_METALIO_E_INK4_PLUS_GLOBAL
    bool
    default y if BOARD_TYPE_METALIO_E_INK4_PLUS && PRODUCT_GLOBAL
config BOARD_TYPE_METALIO_E_INK_4_GLOBAL
    bool
    default y if BOARD_TYPE_METALIO_E_INK_4 && PRODUCT_GLOBAL

config DISPLAY_BACKEND_EPDIY
    bool
    default y if BOARD_TYPE_METALIO_E_INK4_PLUS || BOARD_TYPE_METALIO_E_INK4_PLUS_GLOBAL
config DISPLAY_BACKEND_SSD1677
    bool
    default y if BOARD_TYPE_METALIO_E_INK_4 || BOARD_TYPE_METALIO_E_INK_4_GLOBAL

endmenu
```

## tools/firmware-pocket-skill/metalio-plus-firmware/skills/firmware-build/assets/plus-app-base/sdkconfig.defaults.esp32s31
```kconfig
CONFIG_IDF_TARGET="esp32s31"
CONFIG_ESPTOOLPY_FLASHMODE_DIO=y
CONFIG_ESPTOOLPY_FLASHFREQ_80M=y
CONFIG_ESPTOOLPY_FLASHSIZE_16MB=y
CONFIG_SPIRAM=y
CONFIG_SPIRAM_MODE_OCT=y
CONFIG_SPIRAM_SPEED_200M=y
CONFIG_SPIRAM_USE_MALLOC=y
CONFIG_SPIRAM_MALLOC_ALWAYSINTERNAL=16
CONFIG_SPIRAM_MALLOC_RESERVE_INTERNAL=65536
CONFIG_SPIRAM_BOOT_INIT=y
CONFIG_SPIRAM_ALLOW_STACK_EXTERNAL_MEMORY=y
CONFIG_FREERTOS_TASK_CREATE_ALLOW_EXT_MEM=y
```
