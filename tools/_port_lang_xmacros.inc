    X(BOOK_ANTIALIAS, "抗锯齿", "Anti-aliasing") \
    X(BOOK_BAD_ARG, "参数错误", "Invalid argument") \
    X(BOOK_BLANK, "（空白）", "(Blank)") \
    X(BOOK_BODY, "正文", "Body") \
    X(BOOK_CANCELLED, "已取消", "Cancelled") \
    X(BOOK_CHAPTER_FMT, "第%d章", "Ch.%d") \
    X(BOOK_CHAPTER_NO_TEXT, "（本章无文本）", "(No text in chapter)") \
    X(BOOK_CHAPTER_PROGRESS, "底栏信息", "Footer info") \
    X(BOOK_CHECKSUM_FAIL, "校验失败", "Checksum failed") \
    X(BOOK_CONN_FAIL, "创建连接失败", "Connection failed") \
    X(BOOK_CONTINUE, "继续阅读", "Continue") \
    X(BOOK_COUNT_FMT, "%d本", "%d") \
    X(BOOK_COVER_TOO_LARGE, "封面过大", "Cover too large") \
    X(BOOK_DELETE_FAILED, "删除失败", "Delete failed") \
    X(BOOK_DETAIL, "详情", "Details") \
    X(BOOK_DOWNLOAD_FAIL, "下载失败", "Download failed") \
    X(BOOK_EMPTY_COVER, "空封面", "Empty cover") \
    X(BOOK_EMPTY_FILE, "空文件", "Empty file") \
    X(BOOK_EMPTY_HOME_FMT, "暂无书籍\n请将 .epub / .txt / .ebook\n放到 %s", "No books\nPut .epub / .txt / .ebook\nin %s") \
    X(BOOK_EMPTY_SHELF_FMT, "书架为空\n请将 .epub / .txt / .ebook\n放到 %s", "Bookshelf empty\nPut .epub / .txt / .ebook\nin %s") \
    X(BOOK_FILE_TOO_LARGE, "文件过大", "File too large") \
    X(BOOK_FINISHED, "已看完", "Finished") \
    X(BOOK_FONT_EMPTY, "无可用字体", "No fonts") \
    X(BOOK_FONT_NAME_INVALID, "文件名无效", "Invalid filename") \
    X(BOOK_FONT_TITLE, "字体", "Font") \
    X(BOOK_FOOTER_BATTERY, "电量", "Battery") \
    X(BOOK_FOOTER_PROGRESS, "进度", "Progress") \
    X(BOOK_FOOTER_TIME, "时间", "Time") \
    X(BOOK_FOOTER_TITLE, "章节名", "Chapter") \
    X(BOOK_IMAGE_PLACEHOLDER, "[图片]", "[Image]") \
    X(BOOK_LAYOUT_BUSY, "编排中", "Building") \
    X(BOOK_LAYOUT_DONE, "完成", "Done") \
    X(BOOK_LINE_GAP, "行距", "Line spacing") \
    X(BOOK_MARGIN, "边距", "Margin") \
    X(BOOK_MARGIN_NARROW, "窄", "Narrow") \
    X(BOOK_MARGIN_STANDARD, "标准", "Standard") \
    X(BOOK_MARGIN_VERY_WIDE, "很宽", "Very wide") \
    X(BOOK_MARGIN_WIDE, "宽", "Wide") \
    X(BOOK_NET_NOT_READY, "网络未就绪", "Network not ready") \
    X(BOOK_NO_CONTINUE, "暂无可续", "Nothing to continue") \
    X(BOOK_NO_COVER_URL, "无封面地址", "No cover URL") \
    X(BOOK_NO_DOWNLOAD_URL, "缺少下载地址", "Missing download URL") \
    X(BOOK_NO_LOCAL_FILE, "无本地文件", "No local file") \
    X(BOOK_NO_NETWORK, "无网络", "No network") \
    X(BOOK_NO_RECENT, "暂无最近阅读", "No recent books") \
    X(BOOK_NO_SD, "未检测到 SD 卡\n请插入后重试", "No SD card\nInsert and retry") \
    X(BOOK_NO_SD_SHORT, "未检测到 SD 卡", "No SD card") \
    X(BOOK_OPEN_FAILED, "打开失败", "Open failed") \
    X(BOOK_OPEN_FAILED_CHAPTER, "打开失败\n章节过大或内存不足", "Open failed\nChapter too large or out of memory") \
    X(BOOK_OPEN_FAILED_EPUB, "打开失败\n请检查 EPUB 完整性", "Open failed\nCheck EPUB integrity") \
    X(BOOK_OPEN_FAILED_TASK, "打开失败\n无法启动解析任务", "Open failed\nCannot start parse task") \
    X(BOOK_OPEN_FAILED_TXT, "打开失败\nTXT 过大或内存不足", "Open failed\nTXT too large or out of memory") \
    X(BOOK_OPENING, "正在打开", "Opening") \
    X(BOOK_ORIENT, "屏幕方向", "Orientation") \
    X(BOOK_ORIENT_LAND_LEFT, "左横", "Left") \
    X(BOOK_ORIENT_LAND_RIGHT, "右横", "Right") \
    X(BOOK_ORIENT_PORTRAIT, "竖屏", "Port.") \
    X(BOOK_OUT_OF_MEMORY, "内存不足", "Out of memory") \
    X(BOOK_PAGE_LOAD_FAILED, "无法加载页面", "Cannot load page") \
    X(BOOK_PATH_INVALID, "路径无效", "Invalid path") \
    X(BOOK_READ_DURATION, "阅读时长", "Total time") \
    X(BOOK_READ_FAIL, "读取失败", "Read failed") \
    X(BOOK_READ_FILE_FAIL, "（读文件失败）", "(Read failed)") \
    X(BOOK_READ_PCT_FMT, "已阅读%d.%d%%", "Read %d.%d%%") \
    X(BOOK_RECENT, "最近阅读", "Recent") \
    X(BOOK_SAVE_FAIL, "保存失败", "Save failed") \
    X(BOOK_SELECTED_FMT, "已选 %d", "Selected %d") \
    X(BOOK_SHELF_TITLE, "我的书架", "My bookshelf") \
    X(BOOK_SPACING_COMPACT, "紧凑", "Compact") \
    X(BOOK_SPACING_RELAXED, "宽松", "Relaxed") \
    X(BOOK_SPACING_STANDARD, "标准", "Standard") \
    X(BOOK_SPACING_VERY_RELAXED, "很宽松", "Very relaxed") \
    X(BOOK_START, "开始阅读", "Start reading") \
    X(BOOK_STORAGE_UNAVAIL, "存储目录不可用", "Storage unavailable") \
    X(BOOK_SYNC_EMPTY_BODY, "空请求体", "Empty request body") \
    X(BOOK_TAP_ZONE_BACK, "返回", "Back") \
    X(BOOK_TAP_ZONE_FULL_REFRESH, "全刷一次", "Full refresh") \
    X(BOOK_TAP_ZONE_MENU, "菜单", "Menu") \
    X(BOOK_TAP_ZONE_NEXT, "下一页", "Next") \
    X(BOOK_TAP_ZONE_NONE, "无", "None") \
    X(BOOK_TAP_ZONE_PREV, "上一页", "Prev") \
    X(BOOK_TAP_ZONES, "触摸分区", "Tap zones") \
    X(BOOK_TAP_ZONES_PICK, "选择动作", "Choose action") \
    X(BOOK_TAP_ZONES_RESET, "恢复默认", "Reset") \
    X(BOOK_TAP_ZONES_TITLE, "触摸分区", "Tap zones") \
    X(BOOK_TOC, "目录", "Contents") \
    X(BOOK_TOC_EMPTY, "暂无目录", "No contents") \
    X(BOOK_TOC_PAGE_FMT, "目录 %d/%d", "Contents %d/%d") \
    X(BOOK_TODAY_DURATION, "今日时长", "Today") \
    X(BOOK_UNDERLINE, "下划线", "Underline") \
    X(BOOK_UNDERLINE_DASHED, "虚线", "Dashed") \
    X(BOOK_UNDERLINE_SOLID, "实线", "Solid") \
    X(BOOK_WRITE_FAIL, "写文件失败", "Write failed") \
    X(CLOUD_API_ERROR, "接口返回错误", "API error") \
    X(CLOUD_CANCELLED, "已取消", "Cancelled") \
    X(CLOUD_CANCELLING, "正在取消…", "Cancelling…") \
    X(CLOUD_CONN_FAIL, "创建连接失败", "Connection failed") \
    X(CLOUD_CONNECT_NET, "连接网络…", "Connecting…") \
    X(CLOUD_CONNECTING_NET, "正在联网…", "Connecting…") \
    X(CLOUD_COVER_FAIL, "封面加载失败", "Cover load failed") \
    X(CLOUD_DATA_FORMAT_ERR, "数据格式错误", "Bad data format") \
    X(CLOUD_DECODE_FAIL, "解码失败", "Decode failed") \
    X(CLOUD_DELETE_FAIL, "删除失败", "Delete failed") \
    X(CLOUD_DOWNLOAD_FAIL, "下载失败", "Download failed") \
    X(CLOUD_DOWNLOADING, "正在下载", "Downloading") \
    X(CLOUD_EMPTY_ALL, "暂无待传输资源", "Nothing to transfer") \
    X(CLOUD_EMPTY_BOOK, "暂无书籍", "No books") \
    X(CLOUD_EMPTY_FONT, "暂无字体", "No fonts") \
    X(CLOUD_EMPTY_WALLPAPER, "暂无壁纸", "No Walls") \
    X(CLOUD_FETCHING_LIST, "正在拉取列表…", "Fetching list…") \
    X(CLOUD_FILE_INVALID, "文件无效", "Invalid file") \
    X(CLOUD_IN_QUEUE, "已在队列中", "Already queued") \
    X(CLOUD_JSON_CREATE_FAIL, "JSON 创建失败", "JSON create failed") \
    X(CLOUD_JSON_PARSE_FAIL, "JSON 解析失败", "JSON parse failed") \
    X(CLOUD_JSON_SERIALIZE_FAIL, "JSON 序列化失败", "JSON serialize failed") \
    X(CLOUD_LIST_TOO_LARGE, "列表过大", "List too large") \
    X(CLOUD_LOAD_COVER, "加载封面…", "Loading covers…") \
    X(CLOUD_LOAD_FAIL, "加载失败", "Load failed") \
    X(CLOUD_LOADING, "加载中…", "Loading…") \
    X(CLOUD_MISSING_TASK_ID, "缺少 taskId", "Missing taskId") \
    X(CLOUD_NEED_WIFI_CFG, "请先完成配网", "Set up Wi-Fi first") \
    X(CLOUD_NET_NOT_READY, "网络未就绪", "Network not ready") \
    X(CLOUD_NO_COVER, "暂无封面", "No cover") \
    X(CLOUD_NO_DOWNLOAD_URL, "缺少下载地址", "Missing download URL") \
    X(CLOUD_NO_LOCAL_FILE, "无本地文件", "No local file") \
    X(CLOUD_NO_NETWORK, "无网络", "No network") \
    X(CLOUD_NO_SD, "未检测到 SD 卡", "No SD card") \
    X(CLOUD_PATH_INVALID, "路径无效", "Invalid path") \
    X(CLOUD_PENDING, "待接收", "Incoming") \
    X(CLOUD_PLEASE_WAIT, "请稍候", "Please wait") \
    X(CLOUD_PREVIEW_FAIL, "无法预览", "Cannot preview") \
    X(CLOUD_PREVIEW_START_FAIL, "预览启动失败", "Failed to start preview") \
    X(CLOUD_PREVIEW_URL_LONG, "预览地址过长", "Preview URL too long") \
    X(CLOUD_PUSH_BOOK, "书籍推送", "Book push") \
    X(CLOUD_PUSH_FONT, "字体推送", "Font push") \
    X(CLOUD_PUSH_WALLPAPER, "壁纸推送", "Walls push") \
    X(CLOUD_READ_TIMEOUT, "读取超时或中断", "Read timeout or interrupted") \
    X(CLOUD_REFRESH, "刷新", "Refresh") \
    X(CLOUD_REFRESHED, "已刷新", "Refreshed") \
    X(CLOUD_REFRESHING, "刷新中…", "Refreshing…") \
    X(CLOUD_REQUEST_FAIL, "请求失败", "Request failed") \
    X(CLOUD_SAVE, "保存", "Save") \
    X(CLOUD_SAVE_FAIL, "保存失败", "Save failed") \
    X(CLOUD_SAVE_LOCAL, "保存到本地", "Save to device") \
    X(CLOUD_SAVED_0_1, "已保存 0 / 共 1", "Saved 0 / 1") \
    X(CLOUD_SAVED_FMT, "已保存 %d / 共 %d", "Saved %d / %d") \
    X(CLOUD_SAVED_SYNC_FAIL, "已保存(同步失败)", "Saved (sync failed)") \
    X(CLOUD_SAVING, "正在保存", "Saving") \
    X(CLOUD_SAVING_NAME_FMT, "正在保存\n%s", "Saving\n%s") \
    X(CLOUD_SELECT_FIRST, "请先选择", "Select items first") \
    X(CLOUD_SELECTED_FMT, "已选 %d", "Selected %d") \
    X(CLOUD_STORAGE_UNAVAIL, "存储目录不可用", "Storage unavailable") \
    X(CLOUD_SYNC_FAIL, "同步失败", "Sync failed") \
    X(CLOUD_TAB_ALL, "全部", "All") \
    X(CLOUD_TAB_BOOK, "书籍", "Books") \
    X(CLOUD_TAB_FONT, "字体", "Fonts") \
    X(CLOUD_TAB_WALLPAPER, "壁纸", "Walls") \
    X(CLOUD_TASK_FAIL, "任务失败", "Task failed") \
    X(CLOUD_TYPE_BOOK, "书籍", "Book") \
    X(CLOUD_TYPE_FONT, "字体", "Font") \
    X(CLOUD_TYPE_WALLPAPER, "壁纸", "Walls") \
    X(CLOUD_UNKNOWN_TYPE, "未知类型", "Unknown type") \
    X(CLOUD_WAIT_DOWNLOAD, "请等待下载任务结束", "Wait for download to finish") \
    X(COMMON_DELETE, "删除", "Delete") \
    X(COMMON_EMPTY, "暂无内容", "Empty") \
    X(COMMON_OFF, "关闭", "Off") \
    X(COMMON_ON, "开启", "On") \
    X(STANDBY_CONN_FAIL, "创建连接失败", "Connection failed") \
    X(STANDBY_DATE_FMT, "%02d月%02d日", "%02d/%02d") \
    X(STANDBY_DATE_PLACEHOLDER, "--月--日", "--/--") \
    X(STANDBY_DECODE_FAIL, "解码失败", "Decode failed") \
    X(STANDBY_EMPTY_TODO, "暂无待办", "No todos") \
    X(STANDBY_NO_DATA, "无数据", "No data") \
    X(STANDBY_NO_NETWORK, "无网络", "No network") \
    X(STANDBY_NO_TODO_CACHE, "暂无清单缓存", "No task cache") \
    X(STANDBY_NO_WEATHER, "无天气", "No weather") \
    X(STANDBY_PARSE_FAIL, "解析失败", "Parse failed") \
    X(STANDBY_REQUEST_FAIL, "请求失败", "Request failed") \
    X(STANDBY_WEATHER_FAIL, "天气失败", "Weather failed") \
    X(STANDBY_WP_NOT_FOUND, "未找到待机壁纸", "Standby wallpaper not found") \
    X(WALLPAPER_ADJUST, "调整", "Adjust") \
    X(WALLPAPER_CHIP_SHUTDOWN, "关机", "Power-off") \
    X(WALLPAPER_CHIP_STANDBY, "待机", "Standby") \
    X(WALLPAPER_DECODE_FAIL, "解码失败", "Decode failed") \
    X(WALLPAPER_DELETE_BTN, "删除壁纸", "Delete wallpaper") \
    X(WALLPAPER_DELETE_FAIL, "删除失败", "Delete failed") \
    X(WALLPAPER_DELETE_START_FAIL, "删除启动失败", "Failed to start delete") \
    X(WALLPAPER_DELETING, "正在删除…", "Deleting…") \
    X(WALLPAPER_EMPTY_FMT, "暂无壁纸\n请放到 %s", "No wallpapers\nPlace in %s") \
    X(WALLPAPER_ENABLE_FAIL, "启用失败", "Enable failed") \
    X(WALLPAPER_FILE_INVALID, "文件无效", "Invalid file") \
    X(WALLPAPER_FILE_MISSING, "文件不存在", "File not found") \
    X(WALLPAPER_LOADING, "加载中…", "Loading…") \
    X(WALLPAPER_MIRROR_H, "镜像", "Mirror") \
    X(WALLPAPER_NAME_INVALID, "文件名无效", "Invalid filename") \
    X(WALLPAPER_NO_SD, "未检测到 SD 卡", "No SD card") \
    X(WALLPAPER_OVERWRITE, "覆盖", "Overwrite") \
    X(WALLPAPER_PATH_INVALID, "路径无效", "Invalid path") \
    X(WALLPAPER_PREVIEW_FAIL, "无法预览", "Cannot preview") \
    X(WALLPAPER_PREVIEW_OOM, "内存不足，预览失败", "Out of memory, preview failed") \
    X(WALLPAPER_PREVIEW_START_FAIL, "预览启动失败", "Failed to start preview") \
    X(WALLPAPER_ROTATE_LEFT, "左转", "Left") \
    X(WALLPAPER_ROTATE_RIGHT, "右转", "Right") \
    X(WALLPAPER_SAVE, "保存", "Save") \
    X(WALLPAPER_SAVE_AS, "另存为", "Save as") \
    X(WALLPAPER_SAVE_FAIL, "保存失败", "Save failed") \
    X(WALLPAPER_SAVING, "正在保存…", "Saving…") \
    X(WALLPAPER_SELECTED_FMT, "已选 %d", "Selected %d") \
    X(WALLPAPER_SET_SHUTDOWN, "设为关机", "Set as power-off") \
    X(WALLPAPER_SET_STANDBY, "设为待机", "Set as standby") \
    X(WALLPAPER_SHUTDOWN_ON, "关机中", "Power-off on") \
    X(WALLPAPER_STANDBY_ON, "待机中", "Standby on")
